## arch/powerpc/platforms/512x/Kconfig
```kconfig
config PPC_MPC512x
	bool
	select FSL_SOC
	select IPIC
	default n

config PPC_MPC5121
	bool
	select PPC_MPC512x
	select USB_ARCH_HAS_EHCI
	select USB_EHCI_BIG_ENDIAN_DESC
	select PPC_INDIRECT_PCI
	default n

config MPC5121_ADS_CPLD
	bool
	depends on MPC5121_ADS

config MPC5121_ADS
	bool "Freescale MPC5121E ADS"
	depends on PPC_MULTIPLATFORM && PPC32
	select DEFAULT_UIMAGE
	select WANT_DEVICE_TREE
	select PPC_MPC5121
	select MPC5121_ADS_CPLD if (PCI || TOUCHSCREEN_ADS7846)
	help
	  This option enables support for the MPC5121E ADS board.
	default n

config MPC5121_PM_TEST
	bool "Lowlevel test for Freescale MPC5121E Power Management"
	depends on PM && !CAN_MPC52XX
	---help---
	  Say yes here to enable low level powermanagement test code.
	  It uses the MSCAN modules so the 5121 MSCAN driver must
	  be turned off.
```

## drivers/net/can/Kconfig
```kconfig
menu "CAN Device Drivers"
	depends on CAN

config CAN_VCAN
	tristate "Virtual Local CAN Interface (vcan)"
	depends on CAN
	default N
	---help---
	  Similar to the network loopback devices, vcan offers a
	  virtual local CAN interface.

	  This driver can also be built as a module.  If so, the module
	  will be called vcan.

config CAN_DEBUG_DEVICES
	bool "CAN devices debugging messages"
	depends on CAN
	default N
	---help---
	  Say Y here if you want the CAN device drivers to produce a bunch of
	  debug messages to the system log.  Select this if you are having
	  a problem with CAN support and want to see more of what is going
	  on.

config CAN_MSCAN
	depends on CAN && (PPC || M68K || M68KNOMMU)
	tristate "Support for a Freescale MSCAN based chips"
	---help---
	  The Motorola Scalable Controller Area Network (MSCAN) definition
	  is based on the MSCAN12 definition which is the specific
	  implementation of the Motorola Scalable CAN concept targeted for
	  the Motorola MC68HC12 Microcontroller Family.

config CAN_MPC52XX
	tristate "Freescale MPC5200/MPC5121 onboard CAN controller"
	depends on CAN_MSCAN && (PPC_MPC52xx || PPC_52xx || PPC_MPC5121)
	default LITE5200
	---help---
	  If you say yes here you get support for Freescale MPC5200/MPC5121
	  onboard dualCAN controller.

	  This driver can also be built as a module.  If so, the module
	  will be called mpc52xx_can.

endmenu
```

## drivers/net/fs_enet/Kconfig
```kconfig
config FS_ENET
       tristate "Freescale Ethernet Driver"
       depends on CPM1 || CPM2 || FS_ENET_MPC5121_FEC
       select MII
       select PHYLIB

config FS_ENET_MPC5121_FEC
	bool "Freescale MPC512x FEC driver"
	depends on PPC_MPC512x
	select FS_ENET
	select FS_ENET_HAS_FEC
	select PPC_CPM_NEW_BINDING
	default n

config FS_ENET_HAS_SCC
	bool "Chip has an SCC usable for ethernet"
	depends on FS_ENET && (CPM1 || CPM2)
	default y

config FS_ENET_HAS_FCC
	bool "Chip has an FCC usable for ethernet"
	depends on FS_ENET && CPM2
	default y

config FS_ENET_HAS_FEC
	bool "Chip has an FEC usable for ethernet"
	depends on FS_ENET && (CPM1 || FS_ENET_MPC5121_FEC)
	select FS_ENET_MDIO_FEC
	default y


config FS_ENET_MDIO_FEC
	tristate "MDIO driver for FEC"
	depends on FS_ENET && (CPM1 || FS_ENET_MPC5121_FEC)


config FS_ENET_MDIO_FCC
	tristate "MDIO driver for FCC"
	depends on FS_ENET && CPM2
	select MDIO_BITBANG
```

## sound/soc/fsl/Kconfig
```kconfig
menu "ALSA SoC audio for Freescale SOCs"

config SND_SOC_MPC5121
	bool "ALSA SoC support for the MPC5121 SOC"
	depends on SND_SOC && PPC_MPC512x
	default y if PPC_MPC512x
	help
	  Say Y if you want to add support for codecs attached to a PSC running
	  in I2S/AC97 mode on an MPC5121

choice 
	prompt "ADS5121 Codec Type"
	depends on SND_SOC_MPC5121
	default SND_SOC_MPC5121_ADS

config SND_SOC_MPC5121_ADS
	bool "ADS5121 board with AC97 codec"
	select SND_SOC_AC97_CODEC
        select SND_AC97_CODEC
	help
	  Say Y if you want to enable audio using the LM4550B AC97 codec on a
	  MPC5121ADS, please check your hardware to learn which type of codec
	  is used, and describe it correctly in device tree.

config SND_SOC_MPC5121_I2S
	bool "ADS5121 board with AD1938 I2S codec"
        select SND_SOC_AD1939
	help
	  Say Y if you want to enable audio using the AD1938 I2S codec on a
	  modified MPC5121ADS board.

endchoice


endmenu
```
